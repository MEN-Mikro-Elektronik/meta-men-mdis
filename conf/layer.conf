## conf/layer.conf
```bitbake
# We have a conf directory, add to BBPATH
BBPATH .= ":${LAYERDIR}"

# We have a recipes-* directories, add to BBFILES
BBFILES += "${LAYERDIR}/recipes-*/*/*.bb \
	${LAYERDIR}/recipes-*/*/*.bbappend"

BBFILE_COLLECTIONS += "men-mdis"
BBFILE_PATTERN_men-mdis = "^${LAYERDIR}/"
BBFILE_PRIORITY_men-mdis = "7"

# This should only be incremented on significant changes that will
# cause compatibility issues with other layers
LAYERVERSION_men-mdis = "5"
LAYERSERIES_COMPAT_men-mdis = "sumo dunfell kirkstone"
```
